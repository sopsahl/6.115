/*******************************************************************************
* File Name: cyfittergnu.inc
* 
* PSoC Creator  4.4
*
* Description:
* 
* This file is automatically generated by PSoC Creator.
*
********************************************************************************
* Copyright (c) 2007-2020 Cypress Semiconductor.  All rights reserved.
* You may use this file only in accordance with the license, terms, conditions, 
* disclaimers, and limitations in the end user license agreement accompanying 
* the software package with which this file was provided.
********************************************************************************/

.ifndef INCLUDED_CYFITTERGNU_INC
.set INCLUDED_CYFITTERGNU_INC, 1
.include "cydevicegnu.inc"
.include "cydevicegnu_trm.inc"

/* Fs */
.set Fs__0__INTTYPE, CYREG_PICU1_INTTYPE6
.set Fs__0__MASK, 0x40
.set Fs__0__PC, CYREG_PRT1_PC6
.set Fs__0__PORT, 1
.set Fs__0__SHIFT, 6
.set Fs__AG, CYREG_PRT1_AG
.set Fs__AMUX, CYREG_PRT1_AMUX
.set Fs__BIE, CYREG_PRT1_BIE
.set Fs__BIT_MASK, CYREG_PRT1_BIT_MASK
.set Fs__BYP, CYREG_PRT1_BYP
.set Fs__CTL, CYREG_PRT1_CTL
.set Fs__DM0, CYREG_PRT1_DM0
.set Fs__DM1, CYREG_PRT1_DM1
.set Fs__DM2, CYREG_PRT1_DM2
.set Fs__DR, CYREG_PRT1_DR
.set Fs__INP_DIS, CYREG_PRT1_INP_DIS
.set Fs__INTTYPE_BASE, CYDEV_PICU_INTTYPE_PICU1_BASE
.set Fs__LCD_COM_SEG, CYREG_PRT1_LCD_COM_SEG
.set Fs__LCD_EN, CYREG_PRT1_LCD_EN
.set Fs__MASK, 0x40
.set Fs__PORT, 1
.set Fs__PRT, CYREG_PRT1_PRT
.set Fs__PRTDSI__CAPS_SEL, CYREG_PRT1_CAPS_SEL
.set Fs__PRTDSI__DBL_SYNC_IN, CYREG_PRT1_DBL_SYNC_IN
.set Fs__PRTDSI__OE_SEL0, CYREG_PRT1_OE_SEL0
.set Fs__PRTDSI__OE_SEL1, CYREG_PRT1_OE_SEL1
.set Fs__PRTDSI__OUT_SEL0, CYREG_PRT1_OUT_SEL0
.set Fs__PRTDSI__OUT_SEL1, CYREG_PRT1_OUT_SEL1
.set Fs__PRTDSI__SYNC_OUT, CYREG_PRT1_SYNC_OUT
.set Fs__PS, CYREG_PRT1_PS
.set Fs__SHIFT, 6
.set Fs__SLW, CYREG_PRT1_SLW

/* Clock_1 */
.set Clock_1__CFG0, CYREG_CLKDIST_DCFG1_CFG0
.set Clock_1__CFG1, CYREG_CLKDIST_DCFG1_CFG1
.set Clock_1__CFG2, CYREG_CLKDIST_DCFG1_CFG2
.set Clock_1__CFG2_SRC_SEL_MASK, 0x07
.set Clock_1__INDEX, 0x01
.set Clock_1__PM_ACT_CFG, CYREG_PM_ACT_CFG2
.set Clock_1__PM_ACT_MSK, 0x02
.set Clock_1__PM_STBY_CFG, CYREG_PM_STBY_CFG2
.set Clock_1__PM_STBY_MSK, 0x02

/* SaxKeys */
.set SaxKeys__0__AG, CYREG_PRT4_AG
.set SaxKeys__0__AMUX, CYREG_PRT4_AMUX
.set SaxKeys__0__BIE, CYREG_PRT4_BIE
.set SaxKeys__0__BIT_MASK, CYREG_PRT4_BIT_MASK
.set SaxKeys__0__BYP, CYREG_PRT4_BYP
.set SaxKeys__0__CTL, CYREG_PRT4_CTL
.set SaxKeys__0__DM0, CYREG_PRT4_DM0
.set SaxKeys__0__DM1, CYREG_PRT4_DM1
.set SaxKeys__0__DM2, CYREG_PRT4_DM2
.set SaxKeys__0__DR, CYREG_PRT4_DR
.set SaxKeys__0__INP_DIS, CYREG_PRT4_INP_DIS
.set SaxKeys__0__INTTYPE, CYREG_PICU4_INTTYPE0
.set SaxKeys__0__LCD_COM_SEG, CYREG_PRT4_LCD_COM_SEG
.set SaxKeys__0__LCD_EN, CYREG_PRT4_LCD_EN
.set SaxKeys__0__MASK, 0x01
.set SaxKeys__0__PC, CYREG_PRT4_PC0
.set SaxKeys__0__PORT, 4
.set SaxKeys__0__PRT, CYREG_PRT4_PRT
.set SaxKeys__0__PRTDSI__CAPS_SEL, CYREG_PRT4_CAPS_SEL
.set SaxKeys__0__PRTDSI__DBL_SYNC_IN, CYREG_PRT4_DBL_SYNC_IN
.set SaxKeys__0__PRTDSI__OE_SEL0, CYREG_PRT4_OE_SEL0
.set SaxKeys__0__PRTDSI__OE_SEL1, CYREG_PRT4_OE_SEL1
.set SaxKeys__0__PRTDSI__OUT_SEL0, CYREG_PRT4_OUT_SEL0
.set SaxKeys__0__PRTDSI__OUT_SEL1, CYREG_PRT4_OUT_SEL1
.set SaxKeys__0__PRTDSI__SYNC_OUT, CYREG_PRT4_SYNC_OUT
.set SaxKeys__0__PS, CYREG_PRT4_PS
.set SaxKeys__0__SHIFT, 0
.set SaxKeys__0__SLW, CYREG_PRT4_SLW
.set SaxKeys__1__AG, CYREG_PRT4_AG
.set SaxKeys__1__AMUX, CYREG_PRT4_AMUX
.set SaxKeys__1__BIE, CYREG_PRT4_BIE
.set SaxKeys__1__BIT_MASK, CYREG_PRT4_BIT_MASK
.set SaxKeys__1__BYP, CYREG_PRT4_BYP
.set SaxKeys__1__CTL, CYREG_PRT4_CTL
.set SaxKeys__1__DM0, CYREG_PRT4_DM0
.set SaxKeys__1__DM1, CYREG_PRT4_DM1
.set SaxKeys__1__DM2, CYREG_PRT4_DM2
.set SaxKeys__1__DR, CYREG_PRT4_DR
.set SaxKeys__1__INP_DIS, CYREG_PRT4_INP_DIS
.set SaxKeys__1__INTTYPE, CYREG_PICU4_INTTYPE1
.set SaxKeys__1__LCD_COM_SEG, CYREG_PRT4_LCD_COM_SEG
.set SaxKeys__1__LCD_EN, CYREG_PRT4_LCD_EN
.set SaxKeys__1__MASK, 0x02
.set SaxKeys__1__PC, CYREG_PRT4_PC1
.set SaxKeys__1__PORT, 4
.set SaxKeys__1__PRT, CYREG_PRT4_PRT
.set SaxKeys__1__PRTDSI__CAPS_SEL, CYREG_PRT4_CAPS_SEL
.set SaxKeys__1__PRTDSI__DBL_SYNC_IN, CYREG_PRT4_DBL_SYNC_IN
.set SaxKeys__1__PRTDSI__OE_SEL0, CYREG_PRT4_OE_SEL0
.set SaxKeys__1__PRTDSI__OE_SEL1, CYREG_PRT4_OE_SEL1
.set SaxKeys__1__PRTDSI__OUT_SEL0, CYREG_PRT4_OUT_SEL0
.set SaxKeys__1__PRTDSI__OUT_SEL1, CYREG_PRT4_OUT_SEL1
.set SaxKeys__1__PRTDSI__SYNC_OUT, CYREG_PRT4_SYNC_OUT
.set SaxKeys__1__PS, CYREG_PRT4_PS
.set SaxKeys__1__SHIFT, 1
.set SaxKeys__1__SLW, CYREG_PRT4_SLW
.set SaxKeys__10__AG, CYREG_PRT5_AG
.set SaxKeys__10__AMUX, CYREG_PRT5_AMUX
.set SaxKeys__10__BIE, CYREG_PRT5_BIE
.set SaxKeys__10__BIT_MASK, CYREG_PRT5_BIT_MASK
.set SaxKeys__10__BYP, CYREG_PRT5_BYP
.set SaxKeys__10__CTL, CYREG_PRT5_CTL
.set SaxKeys__10__DM0, CYREG_PRT5_DM0
.set SaxKeys__10__DM1, CYREG_PRT5_DM1
.set SaxKeys__10__DM2, CYREG_PRT5_DM2
.set SaxKeys__10__DR, CYREG_PRT5_DR
.set SaxKeys__10__INP_DIS, CYREG_PRT5_INP_DIS
.set SaxKeys__10__INTTYPE, CYREG_PICU5_INTTYPE2
.set SaxKeys__10__LCD_COM_SEG, CYREG_PRT5_LCD_COM_SEG
.set SaxKeys__10__LCD_EN, CYREG_PRT5_LCD_EN
.set SaxKeys__10__MASK, 0x04
.set SaxKeys__10__PC, CYREG_PRT5_PC2
.set SaxKeys__10__PORT, 5
.set SaxKeys__10__PRT, CYREG_PRT5_PRT
.set SaxKeys__10__PRTDSI__CAPS_SEL, CYREG_PRT5_CAPS_SEL
.set SaxKeys__10__PRTDSI__DBL_SYNC_IN, CYREG_PRT5_DBL_SYNC_IN
.set SaxKeys__10__PRTDSI__OE_SEL0, CYREG_PRT5_OE_SEL0
.set SaxKeys__10__PRTDSI__OE_SEL1, CYREG_PRT5_OE_SEL1
.set SaxKeys__10__PRTDSI__OUT_SEL0, CYREG_PRT5_OUT_SEL0
.set SaxKeys__10__PRTDSI__OUT_SEL1, CYREG_PRT5_OUT_SEL1
.set SaxKeys__10__PRTDSI__SYNC_OUT, CYREG_PRT5_SYNC_OUT
.set SaxKeys__10__PS, CYREG_PRT5_PS
.set SaxKeys__10__SHIFT, 2
.set SaxKeys__10__SLW, CYREG_PRT5_SLW
.set SaxKeys__11__AG, CYREG_PRT5_AG
.set SaxKeys__11__AMUX, CYREG_PRT5_AMUX
.set SaxKeys__11__BIE, CYREG_PRT5_BIE
.set SaxKeys__11__BIT_MASK, CYREG_PRT5_BIT_MASK
.set SaxKeys__11__BYP, CYREG_PRT5_BYP
.set SaxKeys__11__CTL, CYREG_PRT5_CTL
.set SaxKeys__11__DM0, CYREG_PRT5_DM0
.set SaxKeys__11__DM1, CYREG_PRT5_DM1
.set SaxKeys__11__DM2, CYREG_PRT5_DM2
.set SaxKeys__11__DR, CYREG_PRT5_DR
.set SaxKeys__11__INP_DIS, CYREG_PRT5_INP_DIS
.set SaxKeys__11__INTTYPE, CYREG_PICU5_INTTYPE3
.set SaxKeys__11__LCD_COM_SEG, CYREG_PRT5_LCD_COM_SEG
.set SaxKeys__11__LCD_EN, CYREG_PRT5_LCD_EN
.set SaxKeys__11__MASK, 0x08
.set SaxKeys__11__PC, CYREG_PRT5_PC3
.set SaxKeys__11__PORT, 5
.set SaxKeys__11__PRT, CYREG_PRT5_PRT
.set SaxKeys__11__PRTDSI__CAPS_SEL, CYREG_PRT5_CAPS_SEL
.set SaxKeys__11__PRTDSI__DBL_SYNC_IN, CYREG_PRT5_DBL_SYNC_IN
.set SaxKeys__11__PRTDSI__OE_SEL0, CYREG_PRT5_OE_SEL0
.set SaxKeys__11__PRTDSI__OE_SEL1, CYREG_PRT5_OE_SEL1
.set SaxKeys__11__PRTDSI__OUT_SEL0, CYREG_PRT5_OUT_SEL0
.set SaxKeys__11__PRTDSI__OUT_SEL1, CYREG_PRT5_OUT_SEL1
.set SaxKeys__11__PRTDSI__SYNC_OUT, CYREG_PRT5_SYNC_OUT
.set SaxKeys__11__PS, CYREG_PRT5_PS
.set SaxKeys__11__SHIFT, 3
.set SaxKeys__11__SLW, CYREG_PRT5_SLW
.set SaxKeys__12__AG, CYREG_PRT5_AG
.set SaxKeys__12__AMUX, CYREG_PRT5_AMUX
.set SaxKeys__12__BIE, CYREG_PRT5_BIE
.set SaxKeys__12__BIT_MASK, CYREG_PRT5_BIT_MASK
.set SaxKeys__12__BYP, CYREG_PRT5_BYP
.set SaxKeys__12__CTL, CYREG_PRT5_CTL
.set SaxKeys__12__DM0, CYREG_PRT5_DM0
.set SaxKeys__12__DM1, CYREG_PRT5_DM1
.set SaxKeys__12__DM2, CYREG_PRT5_DM2
.set SaxKeys__12__DR, CYREG_PRT5_DR
.set SaxKeys__12__INP_DIS, CYREG_PRT5_INP_DIS
.set SaxKeys__12__INTTYPE, CYREG_PICU5_INTTYPE4
.set SaxKeys__12__LCD_COM_SEG, CYREG_PRT5_LCD_COM_SEG
.set SaxKeys__12__LCD_EN, CYREG_PRT5_LCD_EN
.set SaxKeys__12__MASK, 0x10
.set SaxKeys__12__PC, CYREG_PRT5_PC4
.set SaxKeys__12__PORT, 5
.set SaxKeys__12__PRT, CYREG_PRT5_PRT
.set SaxKeys__12__PRTDSI__CAPS_SEL, CYREG_PRT5_CAPS_SEL
.set SaxKeys__12__PRTDSI__DBL_SYNC_IN, CYREG_PRT5_DBL_SYNC_IN
.set SaxKeys__12__PRTDSI__OE_SEL0, CYREG_PRT5_OE_SEL0
.set SaxKeys__12__PRTDSI__OE_SEL1, CYREG_PRT5_OE_SEL1
.set SaxKeys__12__PRTDSI__OUT_SEL0, CYREG_PRT5_OUT_SEL0
.set SaxKeys__12__PRTDSI__OUT_SEL1, CYREG_PRT5_OUT_SEL1
.set SaxKeys__12__PRTDSI__SYNC_OUT, CYREG_PRT5_SYNC_OUT
.set SaxKeys__12__PS, CYREG_PRT5_PS
.set SaxKeys__12__SHIFT, 4
.set SaxKeys__12__SLW, CYREG_PRT5_SLW
.set SaxKeys__13__AG, CYREG_PRT5_AG
.set SaxKeys__13__AMUX, CYREG_PRT5_AMUX
.set SaxKeys__13__BIE, CYREG_PRT5_BIE
.set SaxKeys__13__BIT_MASK, CYREG_PRT5_BIT_MASK
.set SaxKeys__13__BYP, CYREG_PRT5_BYP
.set SaxKeys__13__CTL, CYREG_PRT5_CTL
.set SaxKeys__13__DM0, CYREG_PRT5_DM0
.set SaxKeys__13__DM1, CYREG_PRT5_DM1
.set SaxKeys__13__DM2, CYREG_PRT5_DM2
.set SaxKeys__13__DR, CYREG_PRT5_DR
.set SaxKeys__13__INP_DIS, CYREG_PRT5_INP_DIS
.set SaxKeys__13__INTTYPE, CYREG_PICU5_INTTYPE5
.set SaxKeys__13__LCD_COM_SEG, CYREG_PRT5_LCD_COM_SEG
.set SaxKeys__13__LCD_EN, CYREG_PRT5_LCD_EN
.set SaxKeys__13__MASK, 0x20
.set SaxKeys__13__PC, CYREG_PRT5_PC5
.set SaxKeys__13__PORT, 5
.set SaxKeys__13__PRT, CYREG_PRT5_PRT
.set SaxKeys__13__PRTDSI__CAPS_SEL, CYREG_PRT5_CAPS_SEL
.set SaxKeys__13__PRTDSI__DBL_SYNC_IN, CYREG_PRT5_DBL_SYNC_IN
.set SaxKeys__13__PRTDSI__OE_SEL0, CYREG_PRT5_OE_SEL0
.set SaxKeys__13__PRTDSI__OE_SEL1, CYREG_PRT5_OE_SEL1
.set SaxKeys__13__PRTDSI__OUT_SEL0, CYREG_PRT5_OUT_SEL0
.set SaxKeys__13__PRTDSI__OUT_SEL1, CYREG_PRT5_OUT_SEL1
.set SaxKeys__13__PRTDSI__SYNC_OUT, CYREG_PRT5_SYNC_OUT
.set SaxKeys__13__PS, CYREG_PRT5_PS
.set SaxKeys__13__SHIFT, 5
.set SaxKeys__13__SLW, CYREG_PRT5_SLW
.set SaxKeys__2__AG, CYREG_PRT4_AG
.set SaxKeys__2__AMUX, CYREG_PRT4_AMUX
.set SaxKeys__2__BIE, CYREG_PRT4_BIE
.set SaxKeys__2__BIT_MASK, CYREG_PRT4_BIT_MASK
.set SaxKeys__2__BYP, CYREG_PRT4_BYP
.set SaxKeys__2__CTL, CYREG_PRT4_CTL
.set SaxKeys__2__DM0, CYREG_PRT4_DM0
.set SaxKeys__2__DM1, CYREG_PRT4_DM1
.set SaxKeys__2__DM2, CYREG_PRT4_DM2
.set SaxKeys__2__DR, CYREG_PRT4_DR
.set SaxKeys__2__INP_DIS, CYREG_PRT4_INP_DIS
.set SaxKeys__2__INTTYPE, CYREG_PICU4_INTTYPE2
.set SaxKeys__2__LCD_COM_SEG, CYREG_PRT4_LCD_COM_SEG
.set SaxKeys__2__LCD_EN, CYREG_PRT4_LCD_EN
.set SaxKeys__2__MASK, 0x04
.set SaxKeys__2__PC, CYREG_PRT4_PC2
.set SaxKeys__2__PORT, 4
.set SaxKeys__2__PRT, CYREG_PRT4_PRT
.set SaxKeys__2__PRTDSI__CAPS_SEL, CYREG_PRT4_CAPS_SEL
.set SaxKeys__2__PRTDSI__DBL_SYNC_IN, CYREG_PRT4_DBL_SYNC_IN
.set SaxKeys__2__PRTDSI__OE_SEL0, CYREG_PRT4_OE_SEL0
.set SaxKeys__2__PRTDSI__OE_SEL1, CYREG_PRT4_OE_SEL1
.set SaxKeys__2__PRTDSI__OUT_SEL0, CYREG_PRT4_OUT_SEL0
.set SaxKeys__2__PRTDSI__OUT_SEL1, CYREG_PRT4_OUT_SEL1
.set SaxKeys__2__PRTDSI__SYNC_OUT, CYREG_PRT4_SYNC_OUT
.set SaxKeys__2__PS, CYREG_PRT4_PS
.set SaxKeys__2__SHIFT, 2
.set SaxKeys__2__SLW, CYREG_PRT4_SLW
.set SaxKeys__3__AG, CYREG_PRT4_AG
.set SaxKeys__3__AMUX, CYREG_PRT4_AMUX
.set SaxKeys__3__BIE, CYREG_PRT4_BIE
.set SaxKeys__3__BIT_MASK, CYREG_PRT4_BIT_MASK
.set SaxKeys__3__BYP, CYREG_PRT4_BYP
.set SaxKeys__3__CTL, CYREG_PRT4_CTL
.set SaxKeys__3__DM0, CYREG_PRT4_DM0
.set SaxKeys__3__DM1, CYREG_PRT4_DM1
.set SaxKeys__3__DM2, CYREG_PRT4_DM2
.set SaxKeys__3__DR, CYREG_PRT4_DR
.set SaxKeys__3__INP_DIS, CYREG_PRT4_INP_DIS
.set SaxKeys__3__INTTYPE, CYREG_PICU4_INTTYPE3
.set SaxKeys__3__LCD_COM_SEG, CYREG_PRT4_LCD_COM_SEG
.set SaxKeys__3__LCD_EN, CYREG_PRT4_LCD_EN
.set SaxKeys__3__MASK, 0x08
.set SaxKeys__3__PC, CYREG_PRT4_PC3
.set SaxKeys__3__PORT, 4
.set SaxKeys__3__PRT, CYREG_PRT4_PRT
.set SaxKeys__3__PRTDSI__CAPS_SEL, CYREG_PRT4_CAPS_SEL
.set SaxKeys__3__PRTDSI__DBL_SYNC_IN, CYREG_PRT4_DBL_SYNC_IN
.set SaxKeys__3__PRTDSI__OE_SEL0, CYREG_PRT4_OE_SEL0
.set SaxKeys__3__PRTDSI__OE_SEL1, CYREG_PRT4_OE_SEL1
.set SaxKeys__3__PRTDSI__OUT_SEL0, CYREG_PRT4_OUT_SEL0
.set SaxKeys__3__PRTDSI__OUT_SEL1, CYREG_PRT4_OUT_SEL1
.set SaxKeys__3__PRTDSI__SYNC_OUT, CYREG_PRT4_SYNC_OUT
.set SaxKeys__3__PS, CYREG_PRT4_PS
.set SaxKeys__3__SHIFT, 3
.set SaxKeys__3__SLW, CYREG_PRT4_SLW
.set SaxKeys__4__AG, CYREG_PRT4_AG
.set SaxKeys__4__AMUX, CYREG_PRT4_AMUX
.set SaxKeys__4__BIE, CYREG_PRT4_BIE
.set SaxKeys__4__BIT_MASK, CYREG_PRT4_BIT_MASK
.set SaxKeys__4__BYP, CYREG_PRT4_BYP
.set SaxKeys__4__CTL, CYREG_PRT4_CTL
.set SaxKeys__4__DM0, CYREG_PRT4_DM0
.set SaxKeys__4__DM1, CYREG_PRT4_DM1
.set SaxKeys__4__DM2, CYREG_PRT4_DM2
.set SaxKeys__4__DR, CYREG_PRT4_DR
.set SaxKeys__4__INP_DIS, CYREG_PRT4_INP_DIS
.set SaxKeys__4__INTTYPE, CYREG_PICU4_INTTYPE4
.set SaxKeys__4__LCD_COM_SEG, CYREG_PRT4_LCD_COM_SEG
.set SaxKeys__4__LCD_EN, CYREG_PRT4_LCD_EN
.set SaxKeys__4__MASK, 0x10
.set SaxKeys__4__PC, CYREG_PRT4_PC4
.set SaxKeys__4__PORT, 4
.set SaxKeys__4__PRT, CYREG_PRT4_PRT
.set SaxKeys__4__PRTDSI__CAPS_SEL, CYREG_PRT4_CAPS_SEL
.set SaxKeys__4__PRTDSI__DBL_SYNC_IN, CYREG_PRT4_DBL_SYNC_IN
.set SaxKeys__4__PRTDSI__OE_SEL0, CYREG_PRT4_OE_SEL0
.set SaxKeys__4__PRTDSI__OE_SEL1, CYREG_PRT4_OE_SEL1
.set SaxKeys__4__PRTDSI__OUT_SEL0, CYREG_PRT4_OUT_SEL0
.set SaxKeys__4__PRTDSI__OUT_SEL1, CYREG_PRT4_OUT_SEL1
.set SaxKeys__4__PRTDSI__SYNC_OUT, CYREG_PRT4_SYNC_OUT
.set SaxKeys__4__PS, CYREG_PRT4_PS
.set SaxKeys__4__SHIFT, 4
.set SaxKeys__4__SLW, CYREG_PRT4_SLW
.set SaxKeys__5__AG, CYREG_PRT4_AG
.set SaxKeys__5__AMUX, CYREG_PRT4_AMUX
.set SaxKeys__5__BIE, CYREG_PRT4_BIE
.set SaxKeys__5__BIT_MASK, CYREG_PRT4_BIT_MASK
.set SaxKeys__5__BYP, CYREG_PRT4_BYP
.set SaxKeys__5__CTL, CYREG_PRT4_CTL
.set SaxKeys__5__DM0, CYREG_PRT4_DM0
.set SaxKeys__5__DM1, CYREG_PRT4_DM1
.set SaxKeys__5__DM2, CYREG_PRT4_DM2
.set SaxKeys__5__DR, CYREG_PRT4_DR
.set SaxKeys__5__INP_DIS, CYREG_PRT4_INP_DIS
.set SaxKeys__5__INTTYPE, CYREG_PICU4_INTTYPE5
.set SaxKeys__5__LCD_COM_SEG, CYREG_PRT4_LCD_COM_SEG
.set SaxKeys__5__LCD_EN, CYREG_PRT4_LCD_EN
.set SaxKeys__5__MASK, 0x20
.set SaxKeys__5__PC, CYREG_PRT4_PC5
.set SaxKeys__5__PORT, 4
.set SaxKeys__5__PRT, CYREG_PRT4_PRT
.set SaxKeys__5__PRTDSI__CAPS_SEL, CYREG_PRT4_CAPS_SEL
.set SaxKeys__5__PRTDSI__DBL_SYNC_IN, CYREG_PRT4_DBL_SYNC_IN
.set SaxKeys__5__PRTDSI__OE_SEL0, CYREG_PRT4_OE_SEL0
.set SaxKeys__5__PRTDSI__OE_SEL1, CYREG_PRT4_OE_SEL1
.set SaxKeys__5__PRTDSI__OUT_SEL0, CYREG_PRT4_OUT_SEL0
.set SaxKeys__5__PRTDSI__OUT_SEL1, CYREG_PRT4_OUT_SEL1
.set SaxKeys__5__PRTDSI__SYNC_OUT, CYREG_PRT4_SYNC_OUT
.set SaxKeys__5__PS, CYREG_PRT4_PS
.set SaxKeys__5__SHIFT, 5
.set SaxKeys__5__SLW, CYREG_PRT4_SLW
.set SaxKeys__6__AG, CYREG_PRT4_AG
.set SaxKeys__6__AMUX, CYREG_PRT4_AMUX
.set SaxKeys__6__BIE, CYREG_PRT4_BIE
.set SaxKeys__6__BIT_MASK, CYREG_PRT4_BIT_MASK
.set SaxKeys__6__BYP, CYREG_PRT4_BYP
.set SaxKeys__6__CTL, CYREG_PRT4_CTL
.set SaxKeys__6__DM0, CYREG_PRT4_DM0
.set SaxKeys__6__DM1, CYREG_PRT4_DM1
.set SaxKeys__6__DM2, CYREG_PRT4_DM2
.set SaxKeys__6__DR, CYREG_PRT4_DR
.set SaxKeys__6__INP_DIS, CYREG_PRT4_INP_DIS
.set SaxKeys__6__INTTYPE, CYREG_PICU4_INTTYPE6
.set SaxKeys__6__LCD_COM_SEG, CYREG_PRT4_LCD_COM_SEG
.set SaxKeys__6__LCD_EN, CYREG_PRT4_LCD_EN
.set SaxKeys__6__MASK, 0x40
.set SaxKeys__6__PC, CYREG_PRT4_PC6
.set SaxKeys__6__PORT, 4
.set SaxKeys__6__PRT, CYREG_PRT4_PRT
.set SaxKeys__6__PRTDSI__CAPS_SEL, CYREG_PRT4_CAPS_SEL
.set SaxKeys__6__PRTDSI__DBL_SYNC_IN, CYREG_PRT4_DBL_SYNC_IN
.set SaxKeys__6__PRTDSI__OE_SEL0, CYREG_PRT4_OE_SEL0
.set SaxKeys__6__PRTDSI__OE_SEL1, CYREG_PRT4_OE_SEL1
.set SaxKeys__6__PRTDSI__OUT_SEL0, CYREG_PRT4_OUT_SEL0
.set SaxKeys__6__PRTDSI__OUT_SEL1, CYREG_PRT4_OUT_SEL1
.set SaxKeys__6__PRTDSI__SYNC_OUT, CYREG_PRT4_SYNC_OUT
.set SaxKeys__6__PS, CYREG_PRT4_PS
.set SaxKeys__6__SHIFT, 6
.set SaxKeys__6__SLW, CYREG_PRT4_SLW
.set SaxKeys__7__AG, CYREG_PRT4_AG
.set SaxKeys__7__AMUX, CYREG_PRT4_AMUX
.set SaxKeys__7__BIE, CYREG_PRT4_BIE
.set SaxKeys__7__BIT_MASK, CYREG_PRT4_BIT_MASK
.set SaxKeys__7__BYP, CYREG_PRT4_BYP
.set SaxKeys__7__CTL, CYREG_PRT4_CTL
.set SaxKeys__7__DM0, CYREG_PRT4_DM0
.set SaxKeys__7__DM1, CYREG_PRT4_DM1
.set SaxKeys__7__DM2, CYREG_PRT4_DM2
.set SaxKeys__7__DR, CYREG_PRT4_DR
.set SaxKeys__7__INP_DIS, CYREG_PRT4_INP_DIS
.set SaxKeys__7__INTTYPE, CYREG_PICU4_INTTYPE7
.set SaxKeys__7__LCD_COM_SEG, CYREG_PRT4_LCD_COM_SEG
.set SaxKeys__7__LCD_EN, CYREG_PRT4_LCD_EN
.set SaxKeys__7__MASK, 0x80
.set SaxKeys__7__PC, CYREG_PRT4_PC7
.set SaxKeys__7__PORT, 4
.set SaxKeys__7__PRT, CYREG_PRT4_PRT
.set SaxKeys__7__PRTDSI__CAPS_SEL, CYREG_PRT4_CAPS_SEL
.set SaxKeys__7__PRTDSI__DBL_SYNC_IN, CYREG_PRT4_DBL_SYNC_IN
.set SaxKeys__7__PRTDSI__OE_SEL0, CYREG_PRT4_OE_SEL0
.set SaxKeys__7__PRTDSI__OE_SEL1, CYREG_PRT4_OE_SEL1
.set SaxKeys__7__PRTDSI__OUT_SEL0, CYREG_PRT4_OUT_SEL0
.set SaxKeys__7__PRTDSI__OUT_SEL1, CYREG_PRT4_OUT_SEL1
.set SaxKeys__7__PRTDSI__SYNC_OUT, CYREG_PRT4_SYNC_OUT
.set SaxKeys__7__PS, CYREG_PRT4_PS
.set SaxKeys__7__SHIFT, 7
.set SaxKeys__7__SLW, CYREG_PRT4_SLW
.set SaxKeys__8__AG, CYREG_PRT5_AG
.set SaxKeys__8__AMUX, CYREG_PRT5_AMUX
.set SaxKeys__8__BIE, CYREG_PRT5_BIE
.set SaxKeys__8__BIT_MASK, CYREG_PRT5_BIT_MASK
.set SaxKeys__8__BYP, CYREG_PRT5_BYP
.set SaxKeys__8__CTL, CYREG_PRT5_CTL
.set SaxKeys__8__DM0, CYREG_PRT5_DM0
.set SaxKeys__8__DM1, CYREG_PRT5_DM1
.set SaxKeys__8__DM2, CYREG_PRT5_DM2
.set SaxKeys__8__DR, CYREG_PRT5_DR
.set SaxKeys__8__INP_DIS, CYREG_PRT5_INP_DIS
.set SaxKeys__8__INTTYPE, CYREG_PICU5_INTTYPE0
.set SaxKeys__8__LCD_COM_SEG, CYREG_PRT5_LCD_COM_SEG
.set SaxKeys__8__LCD_EN, CYREG_PRT5_LCD_EN
.set SaxKeys__8__MASK, 0x01
.set SaxKeys__8__PC, CYREG_PRT5_PC0
.set SaxKeys__8__PORT, 5
.set SaxKeys__8__PRT, CYREG_PRT5_PRT
.set SaxKeys__8__PRTDSI__CAPS_SEL, CYREG_PRT5_CAPS_SEL
.set SaxKeys__8__PRTDSI__DBL_SYNC_IN, CYREG_PRT5_DBL_SYNC_IN
.set SaxKeys__8__PRTDSI__OE_SEL0, CYREG_PRT5_OE_SEL0
.set SaxKeys__8__PRTDSI__OE_SEL1, CYREG_PRT5_OE_SEL1
.set SaxKeys__8__PRTDSI__OUT_SEL0, CYREG_PRT5_OUT_SEL0
.set SaxKeys__8__PRTDSI__OUT_SEL1, CYREG_PRT5_OUT_SEL1
.set SaxKeys__8__PRTDSI__SYNC_OUT, CYREG_PRT5_SYNC_OUT
.set SaxKeys__8__PS, CYREG_PRT5_PS
.set SaxKeys__8__SHIFT, 0
.set SaxKeys__8__SLW, CYREG_PRT5_SLW
.set SaxKeys__9__AG, CYREG_PRT5_AG
.set SaxKeys__9__AMUX, CYREG_PRT5_AMUX
.set SaxKeys__9__BIE, CYREG_PRT5_BIE
.set SaxKeys__9__BIT_MASK, CYREG_PRT5_BIT_MASK
.set SaxKeys__9__BYP, CYREG_PRT5_BYP
.set SaxKeys__9__CTL, CYREG_PRT5_CTL
.set SaxKeys__9__DM0, CYREG_PRT5_DM0
.set SaxKeys__9__DM1, CYREG_PRT5_DM1
.set SaxKeys__9__DM2, CYREG_PRT5_DM2
.set SaxKeys__9__DR, CYREG_PRT5_DR
.set SaxKeys__9__INP_DIS, CYREG_PRT5_INP_DIS
.set SaxKeys__9__INTTYPE, CYREG_PICU5_INTTYPE1
.set SaxKeys__9__LCD_COM_SEG, CYREG_PRT5_LCD_COM_SEG
.set SaxKeys__9__LCD_EN, CYREG_PRT5_LCD_EN
.set SaxKeys__9__MASK, 0x02
.set SaxKeys__9__PC, CYREG_PRT5_PC1
.set SaxKeys__9__PORT, 5
.set SaxKeys__9__PRT, CYREG_PRT5_PRT
.set SaxKeys__9__PRTDSI__CAPS_SEL, CYREG_PRT5_CAPS_SEL
.set SaxKeys__9__PRTDSI__DBL_SYNC_IN, CYREG_PRT5_DBL_SYNC_IN
.set SaxKeys__9__PRTDSI__OE_SEL0, CYREG_PRT5_OE_SEL0
.set SaxKeys__9__PRTDSI__OE_SEL1, CYREG_PRT5_OE_SEL1
.set SaxKeys__9__PRTDSI__OUT_SEL0, CYREG_PRT5_OUT_SEL0
.set SaxKeys__9__PRTDSI__OUT_SEL1, CYREG_PRT5_OUT_SEL1
.set SaxKeys__9__PRTDSI__SYNC_OUT, CYREG_PRT5_SYNC_OUT
.set SaxKeys__9__PS, CYREG_PRT5_PS
.set SaxKeys__9__SHIFT, 1
.set SaxKeys__9__SLW, CYREG_PRT5_SLW

/* Wave_Out */
.set Wave_Out_DMA__DRQ_CTL, CYREG_IDMUX_DRQ_CTL0
.set Wave_Out_DMA__DRQ_NUMBER, 0
.set Wave_Out_DMA__NUMBEROF_TDS, 0
.set Wave_Out_DMA__PRIORITY, 2
.set Wave_Out_DMA__TERMIN_EN, 0
.set Wave_Out_DMA__TERMIN_SEL, 0
.set Wave_Out_DMA__TERMOUT0_EN, 0
.set Wave_Out_DMA__TERMOUT0_SEL, 0
.set Wave_Out_DMA__TERMOUT1_EN, 0
.set Wave_Out_DMA__TERMOUT1_SEL, 0
.set Wave_Out_IntClock__CFG0, CYREG_CLKDIST_DCFG0_CFG0
.set Wave_Out_IntClock__CFG1, CYREG_CLKDIST_DCFG0_CFG1
.set Wave_Out_IntClock__CFG2, CYREG_CLKDIST_DCFG0_CFG2
.set Wave_Out_IntClock__CFG2_SRC_SEL_MASK, 0x07
.set Wave_Out_IntClock__INDEX, 0x00
.set Wave_Out_IntClock__PM_ACT_CFG, CYREG_PM_ACT_CFG2
.set Wave_Out_IntClock__PM_ACT_MSK, 0x01
.set Wave_Out_IntClock__PM_STBY_CFG, CYREG_PM_STBY_CFG2
.set Wave_Out_IntClock__PM_STBY_MSK, 0x01
.set Wave_Out_VDAC8_viDAC8__CR0, CYREG_DAC2_CR0
.set Wave_Out_VDAC8_viDAC8__CR1, CYREG_DAC2_CR1
.set Wave_Out_VDAC8_viDAC8__D, CYREG_DAC2_D
.set Wave_Out_VDAC8_viDAC8__PM_ACT_CFG, CYREG_PM_ACT_CFG8
.set Wave_Out_VDAC8_viDAC8__PM_ACT_MSK, 0x04
.set Wave_Out_VDAC8_viDAC8__PM_STBY_CFG, CYREG_PM_STBY_CFG8
.set Wave_Out_VDAC8_viDAC8__PM_STBY_MSK, 0x04
.set Wave_Out_VDAC8_viDAC8__STROBE, CYREG_DAC2_STROBE
.set Wave_Out_VDAC8_viDAC8__SW0, CYREG_DAC2_SW0
.set Wave_Out_VDAC8_viDAC8__SW2, CYREG_DAC2_SW2
.set Wave_Out_VDAC8_viDAC8__SW3, CYREG_DAC2_SW3
.set Wave_Out_VDAC8_viDAC8__SW4, CYREG_DAC2_SW4
.set Wave_Out_VDAC8_viDAC8__TR, CYREG_DAC2_TR
.set Wave_Out_VDAC8_viDAC8__TRIM__M1, CYREG_FLSHID_CUST_TABLES_DAC2_M1
.set Wave_Out_VDAC8_viDAC8__TRIM__M2, CYREG_FLSHID_CUST_TABLES_DAC2_M2
.set Wave_Out_VDAC8_viDAC8__TRIM__M3, CYREG_FLSHID_CUST_TABLES_DAC2_M3
.set Wave_Out_VDAC8_viDAC8__TRIM__M4, CYREG_FLSHID_CUST_TABLES_DAC2_M4
.set Wave_Out_VDAC8_viDAC8__TRIM__M5, CYREG_FLSHID_CUST_TABLES_DAC2_M5
.set Wave_Out_VDAC8_viDAC8__TRIM__M6, CYREG_FLSHID_CUST_TABLES_DAC2_M6
.set Wave_Out_VDAC8_viDAC8__TRIM__M7, CYREG_FLSHID_CUST_TABLES_DAC2_M7
.set Wave_Out_VDAC8_viDAC8__TRIM__M8, CYREG_FLSHID_CUST_TABLES_DAC2_M8
.set Wave_Out_VDAC8_viDAC8__TST, CYREG_DAC2_TST

/* Waveform */
.set Waveform__0__INTTYPE, CYREG_PICU0_INTTYPE1
.set Waveform__0__MASK, 0x02
.set Waveform__0__PC, CYREG_PRT0_PC1
.set Waveform__0__PORT, 0
.set Waveform__0__SHIFT, 1
.set Waveform__AG, CYREG_PRT0_AG
.set Waveform__AMUX, CYREG_PRT0_AMUX
.set Waveform__BIE, CYREG_PRT0_BIE
.set Waveform__BIT_MASK, CYREG_PRT0_BIT_MASK
.set Waveform__BYP, CYREG_PRT0_BYP
.set Waveform__CTL, CYREG_PRT0_CTL
.set Waveform__DM0, CYREG_PRT0_DM0
.set Waveform__DM1, CYREG_PRT0_DM1
.set Waveform__DM2, CYREG_PRT0_DM2
.set Waveform__DR, CYREG_PRT0_DR
.set Waveform__INP_DIS, CYREG_PRT0_INP_DIS
.set Waveform__INTTYPE_BASE, CYDEV_PICU_INTTYPE_PICU0_BASE
.set Waveform__LCD_COM_SEG, CYREG_PRT0_LCD_COM_SEG
.set Waveform__LCD_EN, CYREG_PRT0_LCD_EN
.set Waveform__MASK, 0x02
.set Waveform__PORT, 0
.set Waveform__PRT, CYREG_PRT0_PRT
.set Waveform__PRTDSI__CAPS_SEL, CYREG_PRT0_CAPS_SEL
.set Waveform__PRTDSI__DBL_SYNC_IN, CYREG_PRT0_DBL_SYNC_IN
.set Waveform__PRTDSI__OE_SEL0, CYREG_PRT0_OE_SEL0
.set Waveform__PRTDSI__OE_SEL1, CYREG_PRT0_OE_SEL1
.set Waveform__PRTDSI__OUT_SEL0, CYREG_PRT0_OUT_SEL0
.set Waveform__PRTDSI__OUT_SEL1, CYREG_PRT0_OUT_SEL1
.set Waveform__PRTDSI__SYNC_OUT, CYREG_PRT0_SYNC_OUT
.set Waveform__PS, CYREG_PRT0_PS
.set Waveform__SHIFT, 1
.set Waveform__SLW, CYREG_PRT0_SLW
.set Waveform_ISR__INTC_CLR_EN_REG, CYREG_NVIC_CLRENA0
.set Waveform_ISR__INTC_CLR_PD_REG, CYREG_NVIC_CLRPEND0
.set Waveform_ISR__INTC_MASK, 0x20000
.set Waveform_ISR__INTC_NUMBER, 17
.set Waveform_ISR__INTC_PRIOR_NUM, 7
.set Waveform_ISR__INTC_PRIOR_REG, CYREG_NVIC_PRI_17
.set Waveform_ISR__INTC_SET_EN_REG, CYREG_NVIC_SETENA0
.set Waveform_ISR__INTC_SET_PD_REG, CYREG_NVIC_SETPEND0
.set Waveform_Send_TimerHW__CAP0, CYREG_TMR0_CAP0
.set Waveform_Send_TimerHW__CAP1, CYREG_TMR0_CAP1
.set Waveform_Send_TimerHW__CFG0, CYREG_TMR0_CFG0
.set Waveform_Send_TimerHW__CFG1, CYREG_TMR0_CFG1
.set Waveform_Send_TimerHW__CFG2, CYREG_TMR0_CFG2
.set Waveform_Send_TimerHW__CNT_CMP0, CYREG_TMR0_CNT_CMP0
.set Waveform_Send_TimerHW__CNT_CMP1, CYREG_TMR0_CNT_CMP1
.set Waveform_Send_TimerHW__PER0, CYREG_TMR0_PER0
.set Waveform_Send_TimerHW__PER1, CYREG_TMR0_PER1
.set Waveform_Send_TimerHW__PM_ACT_CFG, CYREG_PM_ACT_CFG3
.set Waveform_Send_TimerHW__PM_ACT_MSK, 0x01
.set Waveform_Send_TimerHW__PM_STBY_CFG, CYREG_PM_STBY_CFG3
.set Waveform_Send_TimerHW__PM_STBY_MSK, 0x01
.set Waveform_Send_TimerHW__RT0, CYREG_TMR0_RT0
.set Waveform_Send_TimerHW__RT1, CYREG_TMR0_RT1
.set Waveform_Send_TimerHW__SR0, CYREG_TMR0_SR0

/* DACBuffer */
.set DACBuffer_ABuf__CR, CYREG_OPAMP0_CR
.set DACBuffer_ABuf__MX, CYREG_OPAMP0_MX
.set DACBuffer_ABuf__NPUMP_OPAMP_TR0, CYREG_NPUMP_OPAMP_TR0
.set DACBuffer_ABuf__PM_ACT_CFG, CYREG_PM_ACT_CFG4
.set DACBuffer_ABuf__PM_ACT_MSK, 0x01
.set DACBuffer_ABuf__PM_STBY_CFG, CYREG_PM_STBY_CFG4
.set DACBuffer_ABuf__PM_STBY_MSK, 0x01
.set DACBuffer_ABuf__RSVD, CYREG_OPAMP0_RSVD
.set DACBuffer_ABuf__SW, CYREG_OPAMP0_SW
.set DACBuffer_ABuf__TR0, CYREG_OPAMP0_TR0
.set DACBuffer_ABuf__TR1, CYREG_OPAMP0_TR1

/* KeyNote_Low */
.set KeyNote_Low_sts_sts_reg__0__MASK, 0x01
.set KeyNote_Low_sts_sts_reg__0__POS, 0
.set KeyNote_Low_sts_sts_reg__1__MASK, 0x02
.set KeyNote_Low_sts_sts_reg__1__POS, 1
.set KeyNote_Low_sts_sts_reg__16BIT_STATUS_AUX_CTL_REG, CYREG_B0_UDB06_07_ACTL
.set KeyNote_Low_sts_sts_reg__16BIT_STATUS_REG, CYREG_B0_UDB06_07_ST
.set KeyNote_Low_sts_sts_reg__2__MASK, 0x04
.set KeyNote_Low_sts_sts_reg__2__POS, 2
.set KeyNote_Low_sts_sts_reg__3__MASK, 0x08
.set KeyNote_Low_sts_sts_reg__3__POS, 3
.set KeyNote_Low_sts_sts_reg__4__MASK, 0x10
.set KeyNote_Low_sts_sts_reg__4__POS, 4
.set KeyNote_Low_sts_sts_reg__5__MASK, 0x20
.set KeyNote_Low_sts_sts_reg__5__POS, 5
.set KeyNote_Low_sts_sts_reg__6__MASK, 0x40
.set KeyNote_Low_sts_sts_reg__6__POS, 6
.set KeyNote_Low_sts_sts_reg__7__MASK, 0x80
.set KeyNote_Low_sts_sts_reg__7__POS, 7
.set KeyNote_Low_sts_sts_reg__MASK, 0xFF
.set KeyNote_Low_sts_sts_reg__MASK_REG, CYREG_B0_UDB06_MSK
.set KeyNote_Low_sts_sts_reg__STATUS_AUX_CTL_REG, CYREG_B0_UDB06_ACTL
.set KeyNote_Low_sts_sts_reg__STATUS_REG, CYREG_B0_UDB06_ST

/* KeyNote_High */
.set KeyNote_High_sts_sts_reg__0__MASK, 0x01
.set KeyNote_High_sts_sts_reg__0__POS, 0
.set KeyNote_High_sts_sts_reg__1__MASK, 0x02
.set KeyNote_High_sts_sts_reg__1__POS, 1
.set KeyNote_High_sts_sts_reg__16BIT_STATUS_AUX_CTL_REG, CYREG_B1_UDB04_05_ACTL
.set KeyNote_High_sts_sts_reg__16BIT_STATUS_REG, CYREG_B1_UDB04_05_ST
.set KeyNote_High_sts_sts_reg__2__MASK, 0x04
.set KeyNote_High_sts_sts_reg__2__POS, 2
.set KeyNote_High_sts_sts_reg__3__MASK, 0x08
.set KeyNote_High_sts_sts_reg__3__POS, 3
.set KeyNote_High_sts_sts_reg__4__MASK, 0x10
.set KeyNote_High_sts_sts_reg__4__POS, 4
.set KeyNote_High_sts_sts_reg__5__MASK, 0x20
.set KeyNote_High_sts_sts_reg__5__POS, 5
.set KeyNote_High_sts_sts_reg__MASK, 0x3F
.set KeyNote_High_sts_sts_reg__MASK_REG, CYREG_B1_UDB04_MSK
.set KeyNote_High_sts_sts_reg__STATUS_AUX_CTL_REG, CYREG_B1_UDB04_ACTL
.set KeyNote_High_sts_sts_reg__STATUS_REG, CYREG_B1_UDB04_ST

/* Button_Switch */
.set Button_Switch__INTC_CLR_EN_REG, CYREG_NVIC_CLRENA0
.set Button_Switch__INTC_CLR_PD_REG, CYREG_NVIC_CLRPEND0
.set Button_Switch__INTC_MASK, 0x01
.set Button_Switch__INTC_NUMBER, 0
.set Button_Switch__INTC_PRIOR_NUM, 7
.set Button_Switch__INTC_PRIOR_REG, CYREG_NVIC_PRI_0
.set Button_Switch__INTC_SET_EN_REG, CYREG_NVIC_SETENA0
.set Button_Switch__INTC_SET_PD_REG, CYREG_NVIC_SETPEND0

/* Miscellaneous */
.set BCLK__BUS_CLK__HZ, 24000000
.set BCLK__BUS_CLK__KHZ, 24000
.set BCLK__BUS_CLK__MHZ, 24
.set CYDEV_CHIP_DIE_LEOPARD, 1
.set CYDEV_CHIP_DIE_PSOC4A, 26
.set CYDEV_CHIP_DIE_PSOC5LP, 2
.set CYDEV_CHIP_DIE_PSOC5TM, 3
.set CYDEV_CHIP_DIE_TMA4, 4
.set CYDEV_CHIP_DIE_UNKNOWN, 0
.set CYDEV_CHIP_FAMILY_FM0P, 5
.set CYDEV_CHIP_FAMILY_FM3, 6
.set CYDEV_CHIP_FAMILY_FM4, 7
.set CYDEV_CHIP_FAMILY_PSOC3, 1
.set CYDEV_CHIP_FAMILY_PSOC4, 2
.set CYDEV_CHIP_FAMILY_PSOC5, 3
.set CYDEV_CHIP_FAMILY_PSOC6, 4
.set CYDEV_CHIP_FAMILY_UNKNOWN, 0
.set CYDEV_CHIP_FAMILY_USED, CYDEV_CHIP_FAMILY_PSOC5
.set CYDEV_CHIP_JTAG_ID, 0x2E123069
.set CYDEV_CHIP_MEMBER_3A, 1
.set CYDEV_CHIP_MEMBER_4A, 26
.set CYDEV_CHIP_MEMBER_4AA, 25
.set CYDEV_CHIP_MEMBER_4AB, 30
.set CYDEV_CHIP_MEMBER_4AC, 14
.set CYDEV_CHIP_MEMBER_4AD, 15
.set CYDEV_CHIP_MEMBER_4AE, 16
.set CYDEV_CHIP_MEMBER_4D, 20
.set CYDEV_CHIP_MEMBER_4E, 6
.set CYDEV_CHIP_MEMBER_4F, 27
.set CYDEV_CHIP_MEMBER_4G, 4
.set CYDEV_CHIP_MEMBER_4H, 24
.set CYDEV_CHIP_MEMBER_4I, 32
.set CYDEV_CHIP_MEMBER_4J, 21
.set CYDEV_CHIP_MEMBER_4K, 22
.set CYDEV_CHIP_MEMBER_4L, 31
.set CYDEV_CHIP_MEMBER_4M, 29
.set CYDEV_CHIP_MEMBER_4N, 11
.set CYDEV_CHIP_MEMBER_4O, 8
.set CYDEV_CHIP_MEMBER_4P, 28
.set CYDEV_CHIP_MEMBER_4Q, 17
.set CYDEV_CHIP_MEMBER_4R, 9
.set CYDEV_CHIP_MEMBER_4S, 12
.set CYDEV_CHIP_MEMBER_4T, 10
.set CYDEV_CHIP_MEMBER_4U, 5
.set CYDEV_CHIP_MEMBER_4V, 23
.set CYDEV_CHIP_MEMBER_4W, 13
.set CYDEV_CHIP_MEMBER_4X, 7
.set CYDEV_CHIP_MEMBER_4Y, 18
.set CYDEV_CHIP_MEMBER_4Z, 19
.set CYDEV_CHIP_MEMBER_5A, 3
.set CYDEV_CHIP_MEMBER_5B, 2
.set CYDEV_CHIP_MEMBER_6A, 33
.set CYDEV_CHIP_MEMBER_FM3, 37
.set CYDEV_CHIP_MEMBER_FM4, 38
.set CYDEV_CHIP_MEMBER_PDL_FM0P_TYPE1, 34
.set CYDEV_CHIP_MEMBER_PDL_FM0P_TYPE2, 35
.set CYDEV_CHIP_MEMBER_PDL_FM0P_TYPE3, 36
.set CYDEV_CHIP_MEMBER_UNKNOWN, 0
.set CYDEV_CHIP_MEMBER_USED, CYDEV_CHIP_MEMBER_5B
.set CYDEV_CHIP_DIE_EXPECT, CYDEV_CHIP_MEMBER_USED
.set CYDEV_CHIP_DIE_ACTUAL, CYDEV_CHIP_DIE_EXPECT
.set CYDEV_CHIP_REV_LEOPARD_ES1, 0
.set CYDEV_CHIP_REV_LEOPARD_ES2, 1
.set CYDEV_CHIP_REV_LEOPARD_ES3, 3
.set CYDEV_CHIP_REV_LEOPARD_PRODUCTION, 3
.set CYDEV_CHIP_REV_PSOC4A_ES0, 17
.set CYDEV_CHIP_REV_PSOC4A_PRODUCTION, 17
.set CYDEV_CHIP_REV_PSOC5LP_ES0, 0
.set CYDEV_CHIP_REV_PSOC5LP_PRODUCTION, 0
.set CYDEV_CHIP_REV_PSOC5TM_ES0, 0
.set CYDEV_CHIP_REV_PSOC5TM_ES1, 1
.set CYDEV_CHIP_REV_PSOC5TM_PRODUCTION, 1
.set CYDEV_CHIP_REV_TMA4_ES, 17
.set CYDEV_CHIP_REV_TMA4_ES2, 33
.set CYDEV_CHIP_REV_TMA4_PRODUCTION, 17
.set CYDEV_CHIP_REVISION_3A_ES1, 0
.set CYDEV_CHIP_REVISION_3A_ES2, 1
.set CYDEV_CHIP_REVISION_3A_ES3, 3
.set CYDEV_CHIP_REVISION_3A_PRODUCTION, 3
.set CYDEV_CHIP_REVISION_4A_ES0, 17
.set CYDEV_CHIP_REVISION_4A_PRODUCTION, 17
.set CYDEV_CHIP_REVISION_4AA_PRODUCTION, 0
.set CYDEV_CHIP_REVISION_4AB_PRODUCTION, 0
.set CYDEV_CHIP_REVISION_4AC_PRODUCTION, 0
.set CYDEV_CHIP_REVISION_4AD_PRODUCTION, 0
.set CYDEV_CHIP_REVISION_4AE_PRODUCTION, 0
.set CYDEV_CHIP_REVISION_4D_PRODUCTION, 0
.set CYDEV_CHIP_REVISION_4E_CCG2_NO_USBPD, 0
.set CYDEV_CHIP_REVISION_4E_PRODUCTION, 0
.set CYDEV_CHIP_REVISION_4F_PRODUCTION, 0
.set CYDEV_CHIP_REVISION_4F_PRODUCTION_256DMA, 0
.set CYDEV_CHIP_REVISION_4F_PRODUCTION_256K, 0
.set CYDEV_CHIP_REVISION_4G_ES, 17
.set CYDEV_CHIP_REVISION_4G_ES2, 33
.set CYDEV_CHIP_REVISION_4G_PRODUCTION, 17
.set CYDEV_CHIP_REVISION_4H_PRODUCTION, 0
.set CYDEV_CHIP_REVISION_4I_PRODUCTION, 0
.set CYDEV_CHIP_REVISION_4J_PRODUCTION, 0
.set CYDEV_CHIP_REVISION_4K_PRODUCTION, 0
.set CYDEV_CHIP_REVISION_4L_PRODUCTION, 0
.set CYDEV_CHIP_REVISION_4M_PRODUCTION, 0
.set CYDEV_CHIP_REVISION_4N_PRODUCTION, 0
.set CYDEV_CHIP_REVISION_4O_PRODUCTION, 0
.set CYDEV_CHIP_REVISION_4P_PRODUCTION, 0
.set CYDEV_CHIP_REVISION_4Q_PRODUCTION, 0
.set CYDEV_CHIP_REVISION_4R_PRODUCTION, 0
.set CYDEV_CHIP_REVISION_4S_PRODUCTION, 0
.set CYDEV_CHIP_REVISION_4T_PRODUCTION, 0
.set CYDEV_CHIP_REVISION_4U_PRODUCTION, 0
.set CYDEV_CHIP_REVISION_4V_PRODUCTION, 0
.set CYDEV_CHIP_REVISION_4W_PRODUCTION, 0
.set CYDEV_CHIP_REVISION_4X_PRODUCTION, 0
.set CYDEV_CHIP_REVISION_4Y_PRODUCTION, 0
.set CYDEV_CHIP_REVISION_4Z_PRODUCTION, 0
.set CYDEV_CHIP_REVISION_5A_ES0, 0
.set CYDEV_CHIP_REVISION_5A_ES1, 1
.set CYDEV_CHIP_REVISION_5A_PRODUCTION, 1
.set CYDEV_CHIP_REVISION_5B_ES0, 0
.set CYDEV_CHIP_REVISION_5B_PRODUCTION, 0
.set CYDEV_CHIP_REVISION_6A_ES, 17
.set CYDEV_CHIP_REVISION_6A_NO_UDB, 33
.set CYDEV_CHIP_REVISION_6A_PRODUCTION, 33
.set CYDEV_CHIP_REVISION_FM3_PRODUCTION, 0
.set CYDEV_CHIP_REVISION_FM4_PRODUCTION, 0
.set CYDEV_CHIP_REVISION_PDL_FM0P_TYPE1_PRODUCTION, 0
.set CYDEV_CHIP_REVISION_PDL_FM0P_TYPE2_PRODUCTION, 0
.set CYDEV_CHIP_REVISION_PDL_FM0P_TYPE3_PRODUCTION, 0
.set CYDEV_CHIP_REVISION_USED, CYDEV_CHIP_REVISION_5B_PRODUCTION
.set CYDEV_CHIP_REV_EXPECT, CYDEV_CHIP_REVISION_USED
.set CYDEV_CONFIG_FASTBOOT_ENABLED, 1
.set CYDEV_CONFIG_UNUSED_IO_AllowButWarn, 0
.set CYDEV_CONFIG_UNUSED_IO, CYDEV_CONFIG_UNUSED_IO_AllowButWarn
.set CYDEV_CONFIG_UNUSED_IO_AllowWithInfo, 1
.set CYDEV_CONFIG_UNUSED_IO_Disallowed, 2
.set CYDEV_CONFIGURATION_COMPRESSED, 1
.set CYDEV_CONFIGURATION_DMA, 0
.set CYDEV_CONFIGURATION_ECC, 1
.set CYDEV_CONFIGURATION_IMOENABLED, CYDEV_CONFIG_FASTBOOT_ENABLED
.set CYDEV_CONFIGURATION_MODE_COMPRESSED, 0
.set CYDEV_CONFIGURATION_MODE, CYDEV_CONFIGURATION_MODE_COMPRESSED
.set CYDEV_CONFIGURATION_MODE_DMA, 2
.set CYDEV_CONFIGURATION_MODE_UNCOMPRESSED, 1
.set CYDEV_DEBUG_ENABLE_MASK, 0x20
.set CYDEV_DEBUG_ENABLE_REGISTER, CYREG_MLOGIC_DEBUG
.set CYDEV_DEBUGGING_DPS_Disable, 3
.set CYDEV_DEBUGGING_DPS_JTAG_4, 1
.set CYDEV_DEBUGGING_DPS_JTAG_5, 0
.set CYDEV_DEBUGGING_DPS_SWD, 2
.set CYDEV_DEBUGGING_DPS_SWD_SWV, 6
.set CYDEV_DEBUGGING_DPS, CYDEV_DEBUGGING_DPS_SWD_SWV
.set CYDEV_DEBUGGING_ENABLE, 1
.set CYDEV_DEBUGGING_XRES, 0
.set CYDEV_DMA_CHANNELS_AVAILABLE, 24
.set CYDEV_ECC_ENABLE, 0
.set CYDEV_HEAP_SIZE, 0x80
.set CYDEV_INSTRUCT_CACHE_ENABLED, 1
.set CYDEV_INTR_RISING, 0x00000001
.set CYDEV_IS_EXPORTING_CODE, 0
.set CYDEV_IS_IMPORTING_CODE, 0
.set CYDEV_PROJ_TYPE, 0
.set CYDEV_PROJ_TYPE_BOOTLOADER, 1
.set CYDEV_PROJ_TYPE_LAUNCHER, 5
.set CYDEV_PROJ_TYPE_LOADABLE, 2
.set CYDEV_PROJ_TYPE_LOADABLEANDBOOTLOADER, 4
.set CYDEV_PROJ_TYPE_MULTIAPPBOOTLOADER, 3
.set CYDEV_PROJ_TYPE_STANDARD, 0
.set CYDEV_PROTECTION_ENABLE, 0
.set CYDEV_STACK_SIZE, 0x0800
.set CYDEV_USE_BUNDLED_CMSIS, 1
.set CYDEV_VARIABLE_VDDA, 0
.set CYDEV_VDDA_MV, 5000
.set CYDEV_VDDD_MV, 5000
.set CYDEV_VDDIO0_MV, 5000
.set CYDEV_VDDIO1_MV, 5000
.set CYDEV_VDDIO2_MV, 5000
.set CYDEV_VDDIO3_MV, 5000
.set CYDEV_VIO0_MV, 5000
.set CYDEV_VIO1_MV, 5000
.set CYDEV_VIO2_MV, 5000
.set CYDEV_VIO3_MV, 5000
.set CYIPBLOCK_ARM_CM3_VERSION, 0
.set CYIPBLOCK_P3_ANAIF_VERSION, 0
.set CYIPBLOCK_P3_CAN_VERSION, 0
.set CYIPBLOCK_P3_CAPSENSE_VERSION, 0
.set CYIPBLOCK_P3_COMP_VERSION, 0
.set CYIPBLOCK_P3_DECIMATOR_VERSION, 0
.set CYIPBLOCK_P3_DFB_VERSION, 0
.set CYIPBLOCK_P3_DMA_VERSION, 0
.set CYIPBLOCK_P3_DRQ_VERSION, 0
.set CYIPBLOCK_P3_DSM_VERSION, 0
.set CYIPBLOCK_P3_EMIF_VERSION, 0
.set CYIPBLOCK_P3_I2C_VERSION, 0
.set CYIPBLOCK_P3_LCD_VERSION, 0
.set CYIPBLOCK_P3_LPF_VERSION, 0
.set CYIPBLOCK_P3_OPAMP_VERSION, 0
.set CYIPBLOCK_P3_PM_VERSION, 0
.set CYIPBLOCK_P3_SCCT_VERSION, 0
.set CYIPBLOCK_P3_TIMER_VERSION, 0
.set CYIPBLOCK_P3_USB_VERSION, 0
.set CYIPBLOCK_P3_VIDAC_VERSION, 0
.set CYIPBLOCK_P3_VREF_VERSION, 0
.set CYIPBLOCK_S8_GPIO_VERSION, 0
.set CYIPBLOCK_S8_IRQ_VERSION, 0
.set CYIPBLOCK_S8_SAR_VERSION, 0
.set CYIPBLOCK_S8_SIO_VERSION, 0
.set CYIPBLOCK_S8_UDB_VERSION, 0
.set DMA_CHANNELS_USED__MASK0, 0x00000001
.set CYDEV_BOOTLOADER_ENABLE, 0
.endif
